// Device-tree overlay for the CH12 streaming Sobel video pipeline.
//
// PYNQ loads <bitstream>.dtbo alongside <bitstream>.bit, so this has to end up
// on the board as sobel_stream.dtbo next to sobel_stream.bit. Build it with the
// Makefile here.
//
// It exists for one reason: the camera's I2C bus. Everything else in this
// design is driven from userspace through PYNQ's MMIO, but the Pcam 5C is
// brought up by libpcam5c.so through /dev/i2c-N, and a Linux i2c adapter needs
// a device-tree node. The driver finds the right one by walking /dev/i2c-* and
// reading each adapter's label until it sees RPICAM, which is why the label
// below is not decorative.
//
// The address and the interrupt must match the block design:
//   reg        0x80140000  -- assign_bd_address in build_bd.tcl
//   interrupts 0 104 4     -- pl_ps_irq1[0], which is SPI 136; the GIC binding
//                             counts SPIs from 32, so 136 - 32 = 104
//
// Derived from AMD's base overlay device tree (AUP-ZU3/base/dts/base.dtsi,
// Copyright (C) 2025 Advanced Micro Devices, Inc., BSD-3-Clause).

/dts-v1/;
/plugin/;
/ {
	fragment@1 {
		target = <&amba>;
		overlay2: __overlay__ {
			axi_iic: i2c@80140000 {
				#address-cells = <1>;
				#size-cells = <0>;
				clock-names = "s_axi_aclk";
				clocks = <&usb_clk>;
				compatible = "xlnx,axi-iic-2.1", "xlnx,xps-iic-2.1.a";
				interrupt-names = "iic2intc_irpt";
				interrupt-parent = <&gic>;
				interrupts = <0 104 4>;
				reg = <0x0 0x80140000 0x0 0x10000>;
				label = "RPICAM";
			};
		};
	};
};
